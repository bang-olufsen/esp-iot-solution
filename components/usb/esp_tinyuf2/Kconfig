## components/usb/esp_tinyuf2/Kconfig
```kconfig
menu "TinyUF2 Config"
    # We not support disable now
    config ENABLE_UF2_FLASHING
        bool 
        default y if IDF_TARGET_ESP32S2 || IDF_TARGET_ESP32S3
        help
            Enable UF2, only support ESP SoC with USB-OTG
    config UF2_DISK_SIZE_MB
        int "USB Virtual Disk size(MB)"
        depends on ENABLE_UF2_FLASHING
        default 8
        range 4 32 
    config UF2_FLASH_SIZE_MB
        int "Max APP size(MB)"
        depends on ENABLE_UF2_FLASHING
        default 4
        range 2 8
    config FLASH_CACHE_SIZE
        int "Flash cache size(KB)"
        depends on ENABLE_UF2_FLASHING
        default 32
        range 4 64
    config UF2_VOLUME_LABEL
        string "USB Disk Name"
        depends on ENABLE_UF2_FLASHING
        default "ESP32S2-UF2" if IDF_TARGET_ESP32S2
        default "ESP32S3-UF2" if IDF_TARGET_ESP32S3
    config UF2_REV
        string "UF2 Revision"
        depends on ENABLE_UF2_FLASHING
        default "0.1"
    config UF2_INDEX_URL
        string "Product URL"
        depends on ENABLE_UF2_FLASHING
        default "https://products.espressif.com/"
    config UF2_INI_FILE_SIZE
        int "UF2 NVS ini file size"
        depends on ENABLE_UF2_FLASHING
        default 512
        range 256 2048
endmenu
```
